AUTOSAR XML
package /B
  base type u8: base-type-size=8, base-type-encoding=NONE
package /T
  impl type P
    element Value: base-type=u8, compu {}
package /I
  service interface S
    events:
      data E: type=P
package /D
  someip service interface deployment SD: service-interface=S, service-interface-id=1
    someip event deployment ED: event=E, event-id=2
