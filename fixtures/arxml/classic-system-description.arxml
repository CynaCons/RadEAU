AUTOSAR XML (schema 4.0)
package /ClassicSystem
  service instance collection set ClassicInstances
