AUTOSAR XML
package /B
  base type u8: base-type-size=8
package /T
  impl type P
    element V: base-type=u8
package /I
  service interface S
    events:
      data E: type=P
package /D
  someip service interface deployment SD: service-interface=S, service-interface-id=3
    someip event deployment ED: event=E, event-id=4
