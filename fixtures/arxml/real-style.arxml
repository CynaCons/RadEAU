AUTOSAR XML (schema 4.0)
standard types defined: float32, uint64, uint8
package /Units
  unit volt: display-name=V
package /Types
  impl type StatusPayload
    element Voltage: base-type=float32, compu {phys=raw*0.5-0.5; unit V}
    element Timestamp: base-type=uint64
    element Mode: base-type=Bases/uint8, compu {0=off, 0x1=on}
package /Interfaces
  service interface StatusService
    field Status: type=StatusPayload
package /Deployments
  someip service interface deployment StatusDeployment: service-interface=StatusService, service-interface-id=0x4321
    someip event deployment StatusNotifier: field=Status, event-id=0x800A
package /Instances
  provided someip service instance StatusInstance: service-interface-deployment=StatusDeployment, service-instance-id=0x2A
