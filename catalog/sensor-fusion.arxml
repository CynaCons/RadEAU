AUTOSAR XML (schema 4.0)
standard types defined: uint8, uint16, uint32, sint16
package /Units
  6 x unit:
    m: display-name=m
    mps: display-name=m/s
    radps: display-name=rad/s
    mps2: display-name=m/s^2
    ms: display-name=ms
    percent: display-name=%
package /DataTypes
  6 x impl type:
    ObjectList_T
      element ObjectCount: base-type=uint8, compu {identical}
      element FrameCounter: base-type=uint16, compu {identical}
      element ExposureTime: base-type=uint16, compu {phys=raw*0.01; unit ms}
    TargetList_T
      element TargetCount: base-type=uint8, compu {identical}
      element NearestRange: base-type=uint16, compu {phys=raw*0.01; unit m}
      element NearestSpeed: base-type=sint16, compu {phys=raw*0.01; unit m/s}
    ClusterList_T
      element ClusterCount: base-type=uint8, compu {identical}
      element PointCount: base-type=uint32, compu {identical}
      element MeanIntensity: base-type=uint8, compu {phys=raw; unit %}
    DynamicsState_T
      element VehicleSpeed: base-type=uint16, compu {phys=raw*0.01; unit m/s}
      element YawRate: base-type=sint16, compu {phys=raw*0.001; unit rad/s}
      element AccelX: base-type=sint16, compu {phys=raw*0.001; unit m/s^2}
    FusedTrackList_T
      4 x element:
        TrackCount: base-type=uint8, compu {identical}
        QualityMean: base-type=uint8, compu {phys=raw; unit %}
        LeadRange: base-type=uint16, compu {phys=raw*0.01; unit m}
        LeadSpeed: base-type=sint16, compu {phys=raw*0.01; unit m/s}
    FusionStats_T
      element InputLatencyCam: base-type=uint16, compu {phys=raw*0.1; unit ms}
      element MatchedTracks: base-type=uint16, compu {identical}
      element UnmatchedTracks: base-type=uint16, compu {identical}
package /ServiceInterfaces
  5 x service interface:
    CameraObjects
      events:
        data ObjectList: type=ObjectList_T
    RadarTargets
      events:
        data TargetList: type=TargetList_T
    LidarClusters
      events:
        data ClusterList: type=ClusterList_T
    VehicleDynamics
      events:
        data DynamicsState: type=DynamicsState_T
    FusedObjects
      events:
        data FusedTrackList: type=FusedTrackList_T
        data FusionStats: type=FusionStats_T
      methods:
        operation SetFusionMode
package /Deployments
  5 x someip service interface deployment:
    CameraObjects_Deploy: service-interface=CameraObjects, service-interface-id=4353
      someip event deployment ObjectList: event=ObjectList, event-id=32769
    RadarTargets_Deploy: service-interface=RadarTargets, service-interface-id=4354
      someip event deployment TargetList: event=TargetList, event-id=32769
    LidarClusters_Deploy: service-interface=LidarClusters, service-interface-id=4355
      someip event deployment ClusterList: event=ClusterList, event-id=32769
    VehicleDynamics_Deploy: service-interface=VehicleDynamics, service-interface-id=4356
      someip event deployment DynamicsState: event=DynamicsState, event-id=32769
    FusedObjects_Deploy: service-interface=FusedObjects, service-interface-id=4609
      someip event deployment FusedTrackList: event=FusedTrackList, event-id=32769
      someip event deployment FusionStats: event=FusionStats, event-id=32770
      someip method deployment SetFusionMode: method=SetFusionMode, method-id=1
package /Instances
  5 x provided someip service instance, all with service-instance-id=1, udp-port=30490:
    CameraObjects_1: service-interface-deployment=CameraObjects_Deploy, ipv4-address=10.42.0.11
    RadarTargets_1: service-interface-deployment=RadarTargets_Deploy, ipv4-address=10.42.0.12
    LidarClusters_1: service-interface-deployment=LidarClusters_Deploy, ipv4-address=10.42.0.13
    VehicleDynamics_1: service-interface-deployment=VehicleDynamics_Deploy, ipv4-address=10.42.0.14
    FusedObjects_1: service-interface-deployment=FusedObjects_Deploy, ipv4-address=10.42.0.20
