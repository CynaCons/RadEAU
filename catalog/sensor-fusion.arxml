AUTOSAR XML (schema 4.0)
standard types defined: uint8, uint16, uint32, sint16
package /CompuMethods
  compu method Identity: 
  compu method Centi_m: 
  compu method Centi_mps: 
  compu method Milli_radps: 
  compu method Milli_mps2: 
  compu method Deci_ms: 
  compu method Centi_ms: 
  compu method Percent: 
package /DataTypes
  6 x impl type:
    ObjectList_T
      element ObjectCount: base-type=/BaseTypes/uint8, compu-method=/CompuMethods/Identity
      element FrameCounter: base-type=/BaseTypes/uint16, compu-method=/CompuMethods/Identity
      element ExposureTime: base-type=/BaseTypes/uint16, compu-method=/CompuMethods/Centi_ms
    TargetList_T
      element TargetCount: base-type=/BaseTypes/uint8, compu-method=/CompuMethods/Identity
      element NearestRange: base-type=/BaseTypes/uint16, compu-method=/CompuMethods/Centi_m
      element NearestSpeed: base-type=/BaseTypes/sint16, compu-method=/CompuMethods/Centi_mps
    ClusterList_T
      element ClusterCount: base-type=/BaseTypes/uint8, compu-method=/CompuMethods/Identity
      element PointCount: base-type=/BaseTypes/uint32, compu-method=/CompuMethods/Identity
      element MeanIntensity: base-type=/BaseTypes/uint8, compu-method=/CompuMethods/Percent
    DynamicsState_T
      element VehicleSpeed: base-type=/BaseTypes/uint16, compu-method=/CompuMethods/Centi_mps
      element YawRate: base-type=/BaseTypes/sint16, compu-method=/CompuMethods/Milli_radps
      element AccelX: base-type=/BaseTypes/sint16, compu-method=/CompuMethods/Milli_mps2
    FusedTrackList_T
      4 x element:
        TrackCount: base-type=/BaseTypes/uint8, compu-method=/CompuMethods/Identity
        QualityMean: base-type=/BaseTypes/uint8, compu-method=/CompuMethods/Percent
        LeadRange: base-type=/BaseTypes/uint16, compu-method=/CompuMethods/Centi_m
        LeadSpeed: base-type=/BaseTypes/sint16, compu-method=/CompuMethods/Centi_mps
    FusionStats_T
      element InputLatencyCam: base-type=/BaseTypes/uint16, compu-method=/CompuMethods/Deci_ms
      element MatchedTracks: base-type=/BaseTypes/uint16, compu-method=/CompuMethods/Identity
      element UnmatchedTracks: base-type=/BaseTypes/uint16, compu-method=/CompuMethods/Identity
package /ServiceInterfaces
  5 x service interface:
    CameraObjects
      events:
        data ObjectList: type=/DataTypes/ObjectList_T
    RadarTargets
      events:
        data TargetList: type=/DataTypes/TargetList_T
    LidarClusters
      events:
        data ClusterList: type=/DataTypes/ClusterList_T
    VehicleDynamics
      events:
        data DynamicsState: type=/DataTypes/DynamicsState_T
    FusedObjects
      events:
        data FusedTrackList: type=/DataTypes/FusedTrackList_T
        data FusionStats: type=/DataTypes/FusionStats_T
      methods:
        operation SetFusionMode
package /Deployments
  5 x someip service interface deployment:
    CameraObjects_Deploy: service-interface=/ServiceInterfaces/CameraObjects, service-interface-id=4353
      someip event deployment ObjectList: event-id=32769
    RadarTargets_Deploy: service-interface=/ServiceInterfaces/RadarTargets, service-interface-id=4354
      someip event deployment TargetList: event-id=32769
    LidarClusters_Deploy: service-interface=/ServiceInterfaces/LidarClusters, service-interface-id=4355
      someip event deployment ClusterList: event-id=32769
    VehicleDynamics_Deploy: service-interface=/ServiceInterfaces/VehicleDynamics, service-interface-id=4356
      someip event deployment DynamicsState: event-id=32769
    FusedObjects_Deploy: service-interface=/ServiceInterfaces/FusedObjects, service-interface-id=4609
      someip event deployment FusedTrackList: event-id=32769
      someip event deployment FusionStats: event-id=32770
      someip method deployment SetFusionMode: method-id=1
package /Instances
  5 x provided someip service instance, all with service-instance-id=1, udp-port=30490:
    CameraObjects_1: service-interface-deployment=/Deployments/CameraObjects_Deploy, ipv4-address=10.42.0.11
    RadarTargets_1: service-interface-deployment=/Deployments/RadarTargets_Deploy, ipv4-address=10.42.0.12
    LidarClusters_1: service-interface-deployment=/Deployments/LidarClusters_Deploy, ipv4-address=10.42.0.13
    VehicleDynamics_1: service-interface-deployment=/Deployments/VehicleDynamics_Deploy, ipv4-address=10.42.0.14
    FusedObjects_1: service-interface-deployment=/Deployments/FusedObjects_Deploy, ipv4-address=10.42.0.20
